## device/sdkconfig.defaults
```kconfig
CONFIG_HW_POCKETSPRITE=y
CONFIG_ESP32_DEFAULT_CPU_FREQ_240=y
CONFIG_ESPTOOLPY_FLASHSIZE_16MB=y
CONFIG_FREERTOS_HZ=1000
CONFIG_MAIN_TASK_STACK_SIZE=16384
CONFIG_OPTIMIZATION_LEVEL_RELEASE=y
CONFIG_SPI_FLASH_WRITING_DANGEROUS_REGIONS_ALLOWED=y
CONFIG_NEWLIB_NANO_FORMAT=y
```
